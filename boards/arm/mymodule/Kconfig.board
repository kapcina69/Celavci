## boards/arm/mymodule/Kconfig.board
```kconfig
# Copyright (c) 2023 Nordic Semiconductor ASA
# SPDX-License-Identifier: Apache-2.0

config BOARD_MYMODULE
	bool "myModule"
	depends on SOC_NRF52840_QIAA
```

## boards/arm/mymodule/Kconfig.defconfig
```kconfig
# Copyright (c) 2023 Nordic Semiconductor ASA
# SPDX-License-Identifier: Apache-2.0

if BOARD_MYMODULE

config BOARD
	default "mymodule"

config BT_CTLR
   default BT

endif
```
